## config/west.yml
```yaml
manifest:
  remotes:
    - name: zmkfirmware
      url-base: https://github.com/zmkfirmware

    - name: 280Zo
      url-base: https://github.com/280Zo

    - name: iblh
      url-base: https://github.com/iblh

  projects:
    - name: zmk
      remote: zmkfirmware
      revision: 4dd95d7840eb3d5a3f59bb29fbf1ab054715ef85
      import: app/west.yml

    - name: zmk-pmw3610-driver
      remote: 280Zo
      revision: f6e234367b22508b5c0a6bcc82437c64f320089b

    - name: prospector-zmk-module
      remote: iblh
      revision: 1345b3e91e23b8686f2b8b3e121515c6b3e52e84

  self:
    path: config
```

## local-build/trackball-profile/Kconfig.profile
```kconfig
config PMW3610_ALT_PROFILE
    bool "Low-rate optical and motion pipeline diagnostics"
    depends on PMW3610_ALT && LOG && BT
    default n
```
